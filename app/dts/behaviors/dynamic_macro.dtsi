/*
 * Copyright (c) 2026 Serene Industries
 *
 * SPDX-License-Identifier: MIT
 */

/ {
    behaviors {
        // No /omit-if-no-ref/: the stock keymap never references &dmacro, but
        // Studio assigns MC(n) at runtime, so the behavior must always be built.
        dmacro: dynamic_macro {
            compatible = "zmk,behavior-dynamic-macro";
            #binding-cells = <1>;
            display-name = "Macro";
        };
    };
};
